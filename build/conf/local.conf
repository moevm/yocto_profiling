## build/conf/local.conf
```bitbake
MACHINE ??= "qemux86-64"
DISTRO ?= "poky"
EXTRA_IMAGE_FEATURES ?= "debug-tweaks"
USER_CLASSES ?= "buildstats"
PATCHRESOLVE = "noop"
BB_DISKMON_DIRS ??= "\
    STOPTASKS,${TMPDIR},1G,100K \
    STOPTASKS,${DL_DIR},1G,100K \
    STOPTASKS,${SSTATE_DIR},1G,100K \
    STOPTASKS,/tmp,100M,100K \
    HALT,${TMPDIR},100M,1K \
    HALT,${DL_DIR},100M,1K \
    HALT,${SSTATE_DIR},100M,1K \
    HALT,/tmp,10M,1K"
PACKAGECONFIG:append:pn-qemu-system-native = " sdl"



BB_HASHSERVE = "auto"
BB_HASHSERVE_UPSTREAM = "10.138.70.186:8686"
BB_SIGNATURE_HANDLER = "OEEquivHash"

SSTATE_MIRRORS ?= " \
file://.* http://10.138.70.198:9000/sstate-cache/PATH;downloadfilename=PATH \
file://.* http://10.138.70.198:9001/sstate-cache/PATH;downloadfilename=PATH \
file://.* http://10.138.70.198:9002/sstate-cache/PATH;downloadfilename=PATH \
file://.* http://10.138.70.198:9003/sstate-cache/PATH;downloadfilename=PATH \
file://.* http://10.138.70.198:9004/sstate-cache/PATH;downloadfilename=PATH"



CONF_VERSION = "2"
BB_PRESSURE_MAX_CPU = "600000"
BB_PRESSURE_MAX_MEMORY = "700000"
```

## conf/bblayers.conf
```bitbake
# POKY_BBLAYERS_CONF_VERSION is increased each time build/conf/bblayers.conf
# changes incompatibly
POKY_BBLAYERS_CONF_VERSION = "2"

BBPATH = "${TOPDIR}"
BBFILES ?= ""

BBLAYERS ?= " \
  /home/elizaveta/poky/meta \
  /home/elizaveta/poky/meta-poky \
  /home/elizaveta/poky/meta-yocto-bsp \
  /home/elizaveta/poky/meta-virtualization \
  /home/elizaveta/poky/meta-clang \
  /home/elizaveta/poky/meta-python \
  /home/elizaveta/poky/meta-networking \
  /home/elizaveta/poky/meta-filesystems \
  /home/elizaveta/poky/meta-webserver \
  /home/elizaveta/poky/meta-erlang \
  /home/elizaveta/poky/meta-dpdk \
  /home/elizaveta/poky/meta-oe \
  /home/elizaveta/poky/meta-cloud-services \
  "
```

## src/setup_servers/auto_conf/conf/bblayers.conf
```bitbake
# POKY_BBLAYERS_CONF_VERSION is increased each time build/conf/bblayers.conf
# changes incompatibly
POKY_BBLAYERS_CONF_VERSION = "2"

BBPATH = "${TOPDIR}"
BBFILES ?= ""

BBLAYERS ?= " \
  /home/konstantin/server_manual/poky/meta \
  /home/konstantin/server_manual/poky/meta-poky \
  /home/konstantin/server_manual/poky/meta-yocto-bsp \
  "
```

## src/setup_servers/auto_conf/conf/local.conf
```bitbake
MACHINE ??= "qemux86-64"
DISTRO ?= "poky"
EXTRA_IMAGE_FEATURES ?= "debug-tweaks"
USER_CLASSES ?= "buildstats"
PATCHRESOLVE = "noop"
BB_DISKMON_DIRS ??= "\
    STOPTASKS,${TMPDIR},1G,100K \
    STOPTASKS,${DL_DIR},1G,100K \
    STOPTASKS,${SSTATE_DIR},1G,100K \
    STOPTASKS,/tmp,100M,100K \
    HALT,${TMPDIR},100M,1K \
    HALT,${DL_DIR},100M,1K \
    HALT,${SSTATE_DIR},100M,1K \
    HALT,/tmp,10M,1K"
PACKAGECONFIG:append:pn-qemu-system-native = " sdl"
SSTATE_MIRRORS ?= "\ 
file://.* http://10.138.70.6:9000/server_folder_9000/sstate-cache/PATH;downloadfilename=PATH \ 
file://.* http://10.138.70.6:9001/server_folder_9001/sstate-cache/PATH;downloadfilename=PATH \ 
file://.* http://10.138.70.6:9002/server_folder_9002/sstate-cache/PATH;downloadfilename=PATH \ 
file://.* http://10.138.70.6:9003/server_folder_9003/sstate-cache/PATH;downloadfilename=PATH \ 
file://.* http://10.138.70.6:9004/server_folder_9004/sstate-cache/PATH;downloadfilename=PATH \ 
file://.* http://10.138.70.6:9005/server_folder_9005/sstate-cache/PATH;downloadfilename=PATH \ 
file://.* http://10.138.70.6:9006/server_folder_9006/sstate-cache/PATH;downloadfilename=PATH \ 
file://.* http://10.138.70.6:9007/server_folder_9007/sstate-cache/PATH;downloadfilename=PATH \ 
file://.* http://10.138.70.6:9008/server_folder_9008/sstate-cache/PATH;downloadfilename=PATH \ 
file://.* http://10.138.70.6:9009/server_folder_9009/sstate-cache/PATH;downloadfilename=PATH"

BB_HASHSERVE = "auto" 
BB_HASHSERVE_UPSTREAM = "10.138.70.23:8686" 
BB_SIGNATURE_HANDLER = "OEEquivHash" 

CONF_VERSION = "2"
```

## wiki/experiments/cache_experiment/meta-user/conf/layer.conf
```bitbake
LAYERSERIES_COMPAT_meta-user = "rocko thud"
BBPATH .= ":${LAYERDIR}"

BBFILES ?= ""
BBFILES += "${LAYERDIR}/*/*.bb ${LAYERDIR}/*/*.bbappend"
```
